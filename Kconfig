## Kconfig
```kconfig
menu "TB45 Application Options"

config TIBBIT_45
    bool "Enable Tibbit 45 library"
    default y
    help
      Enable the Tibbit 45 cellular modem library and related drivers.

config APP_TB45_SHOW_AVAILABLE_COMMANDS_MENU
    bool "Show TB45 available commands banner at startup"
    default y
    help
      Print the TB45 "Available commands" menu during startup finalization.
      Set this to n to keep startup output minimal.

config APP_TB45_PPP_CHECK_WARN_LOGS
    bool "Enable TB45 checkpoint warning logs"
    default y
    help
      Control LOG_WRN output for startup checkpoint progress messages.
      Set to n to silence checkpoint warning logs while keeping checkpoint logic active.

config APP_TB45_SIM_PIN_ENABLE
    bool "Enable SIM PIN unlock command during modem init"
    default n
    help
      Send AT+CPIN with a configured PIN during SIM7080 init.
      Keep disabled for SIM cards that do not require PIN unlock.

config APP_TB45_SIM_PIN
    string "SIM PIN value"
    default "0000"
    depends on APP_TB45_SIM_PIN_ENABLE
    help
      SIM PIN used by AT+CPIN during modem initialization.
      Valid SIM PIN length is usually 4 to 8 digits.

config APP_TB45_MODEM_APN
    string "Custom modem APN (out-of-tree modem driver)"
    default "internet"
    help
      APN used by the out-of-tree modem cellular custom driver.
      This maps to CONFIG_MODEM_CELLULAR_APN behavior when the built-in
      MODEM_CELLULAR Kconfig path is not active.

config APP_TB45_MODEM_BRINGUP_MAX_RETRIES
    int "Custom modem bring-up max retries (out-of-tree modem driver)"
    default 30
    range 0 10000
    help
      Maximum bring-up retries for the custom modem driver.
      Set to 0 for infinite retries.
      This maps to CONFIG_MODEM_CELLULAR_BRINGUP_MAX_RETRIES behavior.

config APP_TB45_MODEM_NEW_BAUDRATE
    int "Custom modem new baudrate (out-of-tree modem driver)"
    default 115200
    range 9600 4000000
    help
      Target UART baudrate used by the custom modem driver where applicable.
      This maps to CONFIG_MODEM_CELLULAR_NEW_BAUDRATE behavior.

config APP_TB45_MODEM_UART_BUFFER_SIZES
    int "Custom modem UART RX/TX buffer size (out-of-tree modem driver)"
    default 512
    range 64 4096
    help
      UART backend receive/transmit buffer size used by the custom modem driver.
      This maps to CONFIG_MODEM_CELLULAR_UART_BUFFER_SIZES behavior.

config APP_TB45_MODEM_CHAT_BUFFER_SIZE
    int "Custom modem chat buffer size (out-of-tree modem driver)"
    default 128
    range 32 1024
    help
      Chat parser receive buffer size used by the custom modem driver.
      This maps to CONFIG_MODEM_CELLULAR_CHAT_BUFFER_SIZE behavior.

config APP_TB45_MODEM_USER_PIPE_BUFFER_SIZES
    int "Custom modem user pipe buffer size (out-of-tree modem driver)"
    default 128
    range 32 1024
    help
      User pipe receive buffer size used by the custom modem driver.
      This maps to CONFIG_MODEM_CELLULAR_USER_PIPE_BUFFER_SIZES behavior.

config APP_TB45_MODEM_INIT_PRIORITY
    int "Custom modem init priority (out-of-tree modem driver)"
    default 79
    range 0 999
    help
      Initialization priority used by the custom modem driver.
      This maps to CONFIG_MODEM_CELLULAR_INIT_PRIORITY behavior.

config APP_TB45_MODEM_NEW_BAUDRATE_DELAY
    int "Custom modem baudrate switch delay in ms (out-of-tree modem driver)"
    default 300
    range 0 60000
    help
      Delay after baudrate change command in milliseconds.
      This maps to CONFIG_MODEM_CELLULAR_NEW_BAUDRATE_DELAY behavior.

config APP_TB45_MODEM_RESET_POWER_ON_DELAY_MS
    int "Custom modem reset-to-power-on delay in ms (out-of-tree modem driver)"
    default 500
    range 0 60000
    help
      Delay between reset and power-on phases in milliseconds.
      This maps to CONFIG_MODEM_CELLULAR_RESET_POWER_ON_DELAY_MS behavior.

config APP_TB45_MODEM_PERIODIC_SCRIPT_MS
    int "Custom modem periodic script interval in ms (out-of-tree modem driver)"
    default 10000
    range 100 600000
    help
      Periodic script interval used by modem bring-up/health checks.
      This maps to CONFIG_MODEM_CELLULAR_PERIODIC_SCRIPT_MS behavior.

config APP_TB45_PING_COUNT_DEFAULT
    int "Default ping count for tb45 net ping"
    default 4
    range 1 100
    help
      Default ICMP echo request count used when count is omitted.

config APP_TB45_ASYNC_JOB_QUEUE_DEPTH
    int "TB45 async job queue depth"
    default 4
    range 1 32
    help
      Number of jobs buffered by the shared TB45 async queue (SMS + PING).

config APP_TB45_ASYNC_JOB_STACK_SIZE
    int "TB45 async job worker stack size"
    default 4096
    range 1024 16384
    help
      Stack size for the shared TB45 async worker thread.

config APP_TB45_ASYNC_JOB_PRIORITY
    int "TB45 async job worker priority"
    default 7
    range -16 15
    help
      Zephyr thread priority for the shared TB45 async worker thread.

config APP_TB45_ASYNC_SMS_JOB_EXTRA_RETRIES
    int "Extra retries for async SMS jobs"
    default 0
    range 0 5
    help
      Additional dispatcher-level retries after the first SMS job attempt.

config APP_TB45_ASYNC_SMS_JOB_RETRY_DELAY_MS
    int "Retry delay for async SMS jobs (ms)"
    default 1000
    range 0 60000
    help
      Delay between dispatcher-level SMS job retry attempts.

config APP_TB45_ASYNC_PING_JOB_EXTRA_RETRIES
    int "Extra retries for async PING jobs"
    default 0
    range 0 5
    help
      Additional dispatcher-level retries after the first PING job attempt.

config APP_TB45_ASYNC_PING_JOB_RETRY_DELAY_MS
    int "Retry delay for async PING jobs (ms)"
    default 1000
    range 0 60000
    help
      Delay between dispatcher-level PING job retry attempts.

config APP_TB45_ASYNC_PING_HOST_MAX_LEN
    int "Maximum host string length for async PING jobs"
    default 63
    range 7 255
    help
      Maximum host string length accepted by tb45_ping_enqueue().

config APP_TB45_ASYNC_PING_DEFAULT_COUNT
    int "Default count for async PING jobs"
    default 4
    range 1 100
    help
      Default ICMP request count when tb45_ping_enqueue() receives count=0.

config APP_TB45_ASYNC_PING_MAX_COUNT
    int "Maximum count for async PING jobs"
    default 20
    range 1 1000
    help
      Upper bound for ICMP request count accepted by tb45_ping_enqueue().

config APP_TB45_ASYNC_PING_DEFAULT_TIMEOUT_MS
    int "Default timeout for async PING jobs (ms)"
    default 2000
    range 100 60000
    help
      Default per-request timeout when tb45_ping_enqueue() receives timeout_ms=0.

config APP_TB45_ASYNC_PING_MIN_TIMEOUT_MS
    int "Minimum timeout for async PING jobs (ms)"
    default 100
    range 10 60000
    help
      Lower bound for timeout accepted by tb45_ping_enqueue().

config APP_TB45_ASYNC_PING_MAX_TIMEOUT_MS
    int "Maximum timeout for async PING jobs (ms)"
    default 10000
    range 100 120000
    help
      Upper bound for timeout accepted by tb45_ping_enqueue().

config APP_TB45_GOOGLE_IPV4
    string "IPv4 target used by runtime internet probe"
    default "8.8.8.8"
    help
      IPv4 address used by runtime internet reachability probe
      (for example in tb45 show ppp_info).

config APP_TB45_PPP_PERIODIC_PROBE_INTERVAL_MS
    int "Periodic PPP internet probe interval in ms (0 to disable)"
    default 30000
    range 0 3600000
    help
      Interval for periodic internet probes after startup finalization.
      This reuses the same ping probe used by the boot-time
      reachability check.
      Set to 0 to disable periodic checks.

config APP_TB45_PPP_PERIODIC_RECOVERY_COOLDOWN_MS
    int "Cooldown before periodic PPP health can trigger another recovery (ms)"
    default 60000
    range 0 3600000
    help
      Minimum time between consecutive periodic health-triggered recoveries.
      Set to 0 to allow immediate retriggering on repeated failures.

config APP_TB45_SMS_TEXT_MAX_LEN
    int "Maximum SMS text length"
    default 160
    range 1 1600
    help
      Maximum number of characters allowed in an SMS message.
      Note: Values over 160 may require concatenation or different encoding.

config APP_TB45_SMS_PHONE_MAX_LEN
    int "Maximum SMS phone number length"
    default 24
    range 3 64
    help
      Maximum number of characters allowed in a destination phone number,
      including an optional leading '+'.

config APP_TB45_SMS_SEND_ATTEMPT_TIMEOUT_MS
    int "SMS send attempt timeout in milliseconds"
    default 90000
    range 100 600000
    help
      Timeout for one SMS submit attempt after receiving the CMGS prompt.

config APP_TB45_SMS_SEND_MAX_RETRIES
    int "Maximum retries for SMS send"
    default 3
    range 0 20
    help
      Number of retries after a failed send attempt.
      0 means a single attempt with no retries.

config APP_TB45_SMS_SEND_RETRY_DELAY_MS
    int "SMS retry delay in milliseconds"
    default 3000
    range 0 600000
    help
      Delay between SMS send retry attempts.

config APP_TB45_SMS_INIT_WAIT_MS
    int "Initial SMS init wait in milliseconds"
    default 10000
    range 0 600000
    help
      Delay after PPP down before issuing SMS init AT commands.

config APP_TB45_SMS_INIT_AT_TIMEOUT_MS
    int "SMS init AT command timeout in milliseconds"
    default 10000
    range 100 600000
    help
      Timeout used by AT commands during the SMS init sequence.

config APP_TB45_SMS_RESULT_QUEUE_DEPTH
    int "SMS async result queue depth"
    default 16
    range 1 128
    help
      Number of completed SMS results buffered for later retrieval by
      request id or by wait/pop API.

config APP_TB45_SMS_TRIGGER_EVENT_PATH
    bool "Enable SMS serial EVENT trigger path"
    default y
    help
      Enable serial receive event publication for SMS event callbacks.

config APP_TB45_SMS_EVENT_QUEUE_DEPTH
    int "SMS event queue depth"
    default 16
    range 1 128
    help
      Number of SMS events buffered before callback dispatch.

config APP_TB45_SMS_EVENT_WORKER_STACK_SIZE
    int "SMS event worker stack size"
    default 2048
    range 1024 8192
    help
      Stack size for SMS event dispatcher worker thread.

config APP_TB45_SMS_EVENT_WORKER_PRIORITY
    int "SMS event worker priority"
    default 8
    range -16 15
    help
      Priority for SMS event dispatcher worker thread.

config APP_TB45_SMS_SERIAL_RX_DEBOUNCE_MS
    int "SMS serial RX event debounce (ms)"
    default 1000
    range 0 60000
    help
      Minimum interval between published serial RX events.

config APP_TB45_SMS_RESULT_WORKER_ENABLE
    bool "Enable SMS final-result worker"
    default y
    help
      Start a dedicated worker that consumes tb45_sms_result_wait() and
      publishes final send result events.

config APP_TB45_SMS_RESULT_WORKER_STACK_SIZE
    int "SMS result worker stack size"
    default 2048
    range 1024 8192
    depends on APP_TB45_SMS_RESULT_WORKER_ENABLE
    help
      Stack size for SMS result worker thread.

config APP_TB45_SMS_RESULT_WORKER_PRIORITY
    int "SMS result worker priority"
    default 8
    range -16 15
    depends on APP_TB45_SMS_RESULT_WORKER_ENABLE
    help
      Priority for SMS result worker thread.

config APP_TB45_SMS_RX_TRIGGER_QUEUE_DEPTH
    int "SMS receive trigger queue depth"
    default 8
    range 1 64
    help
      Number of pending SMS receive triggers buffered from serial/CMTI events.

config APP_TB45_SMS_RX_RESULT_QUEUE_DEPTH
    int "SMS receive result queue depth"
    default 16
    range 1 128
    help
      Number of parsed inbound SMS messages buffered for tb45_sms_receive_wait().

config APP_TB45_SMS_RX_WORKER_STACK_SIZE
    int "SMS receive worker stack size"
    default 3072
    range 1024 8192
    help
      Stack size for SMS receive worker thread.

config APP_TB45_SMS_RX_WORKER_PRIORITY
    int "SMS receive worker priority"
    default 8
    range -16 15
    help
      Priority for SMS receive worker thread.

config APP_TB45_SMS_RX_STORAGE
    string "SMS receive storage memory (ME or SM)"
    default "ME"
    help
      Storage target configured via AT+CPMS for receive/read/delete operations.

config APP_TB45_SMS_RX_AUTO_DELETE
    bool "Auto-delete SMS after successful receive processing"
    default y
    help
      Execute AT+CMGD=<index> after successful parse/dispatch of one message.

config APP_TB45_SMS_RX_STARTUP_CLEANUP
    bool "Delete all existing SMS once at startup"
    default y
    help
      Execute AT+CMGD=1,4 after receive setup to start from a clean state.

endmenu
```
